## rpi_yoct/conf/bblayers.conf
```bitbake
# POKY_BBLAYERS_CONF_VERSION is increased each time build/conf/bblayers.conf
# changes incompatibly
POKY_BBLAYERS_CONF_VERSION = "2"

BBPATH = "${TOPDIR}"
BBFILES ?= ""

BBLAYERS ?= " \
  /home/jakhon37/myspace/embaDED/YOCTO/poky/meta \
  /home/jakhon37/myspace/embaDED/YOCTO/poky/meta-poky \
  /home/jakhon37/myspace/embaDED/YOCTO/poky/meta-yocto-bsp \
  /home/jakhon37/myspace/embaDED/YOCTO/meta-openembedded/meta-oe \
  /home/jakhon37/myspace/embaDED/YOCTO/meta-openembedded/meta-python \
  /home/jakhon37/myspace/embaDED/YOCTO/meta-raspberrypi \
  /home/jakhon37/myspace/embaDED/YOCTO/meta-openembedded/meta-networking \
  /home/jakhon37/myspace/embaDED/YOCTO/meta-openembedded/meta-multimedia \
  "
```
